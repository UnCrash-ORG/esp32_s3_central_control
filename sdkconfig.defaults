## sdkconfig.defaults
```kconfig
# WiFi - 按你的实际 SSID/密码修改，或改成 AP 模式
CONFIG_ESP_WIFI_STA_MAX_CONCURRENT=0
CONFIG_ESP_HTTP_SERVER_MAX_OPEN_CONNECTIONS=6
CONFIG_HTTPD_MAX_REQ_HDR_LEN=512
CONFIG_HTTPD_MAX_URI_LEN=256

# 增大堆栈，WS 任务需要
CONFIG_COMPILER_STACK_CHECK=y
CONFIG_LOG_DEFAULT_LEVEL_INFO=y

# PSRAM (S3 用得上，若不用可删掉)
# CONFIG_ESP32S3_DEFAULT_CPU_FREQ_240=y
```
